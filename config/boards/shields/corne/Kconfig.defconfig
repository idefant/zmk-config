## config/boards/shields/corne/Kconfig.defconfig
```kconfig
if SHIELD_CORNE_DONGLE

# Max 16 characters in keyboard name
config ZMK_KEYBOARD_NAME
    default "Corne Dongle"

config ZMK_SPLIT
    default y

config ZMK_SPLIT_ROLE_CENTRAL
    default y

# Two peripherals: corne_left + corne_right
config ZMK_SPLIT_BLE_CENTRAL_PERIPHERALS
    default 2

# Peripherals (2) + desired host profiles (default 5) = 7
config BT_MAX_CONN
    default 7

config BT_MAX_PAIRED
    default 7

endif
```

## config/boards/shields/corne/Kconfig.shield
```kconfig
# No whitespace after the comma or in the shield name!
config SHIELD_CORNE_DONGLE
    def_bool $(shields_list_contains,corne_dongle)
```

## config/west.yml
```yaml
manifest:
  remotes:
    - name: zmkfirmware
      url-base: https://github.com/zmkfirmware
    - name: dhruvinsh
      url-base: https://github.com/dhruvinsh
    - name: idefant
      url-base: https://github.com/idefant
  projects:
    - name: zmk
      remote: zmkfirmware
      revision: v0.3.0
      import: app/west.yml
    - name: zmk-tri-state
      remote: dhruvinsh
      revision: ebbc1f0ccdb51669650bb0ac3e34920d09e62400 # Mar 17, 2025, 12:01 AM GMT+5
    - name: zmk-caps-word-ru
      remote: idefant
      revision: main

  self:
    path: config
```
